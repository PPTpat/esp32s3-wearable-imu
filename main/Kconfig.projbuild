## main/Kconfig.projbuild
```kconfig
menu "Wearable IMU"

    config IMU_I2C_SDA_GPIO
        int "I2C SDA GPIO"
        default 8

    config IMU_I2C_SCL_GPIO
        int "I2C SCL GPIO"
        default 9

    config IMU_USE_INT1
        bool "Use the sensor INT1 pin (otherwise the FIFO is polled)"
        default n

    config IMU_INT1_GPIO
        int "LSM6DSOX INT1 GPIO"
        depends on IMU_USE_INT1
        default 4

    config IMU_POLL_PERIOD_MS
        int "FIFO polling period (ms)"
        depends on !IMU_USE_INT1
        range 5 500
        default 50

    config IMU_I2C_FREQ_HZ
        int "I2C clock frequency (Hz)"
        default 400000

    config IMU_ADDR_SA0_HIGH
        bool "SA0 pin tied to VDD (address 0x6B instead of 0x6A)"
        default n

endmenu
```
